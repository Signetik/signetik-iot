## CMakeLists.txt
```
# /*============================================================================*
#  *         Copyright © 2019-2020 Signetik, LLC -- All Rights Reserved         *
#  *----------------------------------------------------------------------------*
#  *                                                              Signetik, LLC *
#  *                                                           www.signetik.com *
#  *                                      SPDX-License-Identifier: BSD-4-Clause *
#  *============================================================================*/

cmake_minimum_required(VERSION 3.8.2)

include($ENV{ZEPHYR_BASE}/cmake/app/boilerplate.cmake NO_POLICY_SCOPE)
project(signetik-client)

macro(zephyr_library_named_o name)
  # This is a macro because we need add_library() to be executed
  # within the scope of the caller.
  set(ZEPHYR_CURRENT_LIBRARY ${name})
  add_library(${name} OBJECT "")

  zephyr_append_cmake_library(${name})

  target_link_libraries(${name} PUBLIC zephyr_interface)
endmacro()

# Main app
target_sources(app PRIVATE src/main.c)
target_sources(app PRIVATE src/LTE_task.c)
target_sources(app PRIVATE src/accel_task.c)
target_sources(app PRIVATE src/temp_humidity_task.c)
target_sources(app PRIVATE src/main_task.c)
target_sources(app PRIVATE src/cell_packet.c)

add_library (sigcoap STATIC IMPORTED libsigcoap.a)
set_target_properties(sigcoap PROPERTIES IMPORTED_LOCATION ${ZEPHYR_BASE}/../signetik-iot-pub/signetik_client_rel/lib/libsigcoap.a)

# Link library
target_link_libraries (app PRIVATE sigcoap)
```

## Kconfig
```
# /*============================================================================*
# *         Copyright © 2019-2020 Signetik, LLC -- All Rights Reserved         *
# *----------------------------------------------------------------------------*
# *                                                              Signetik, LLC *
# *                                                           www.signetik.com *
# *                                      SPDX-License-Identifier: BSD-4-Clause *
# *============================================================================*/

menu "Signetik client sample"

config COAP_RESOURCE
	string "CoAP resource - defaults to Californium observable resource"
	default "obs"

config COAP_SERVER_HOSTNAME
	string "CoAP server hostname"
	default "44.228.49.27"	 #Signetik-IoT

config COAP_SERVER_PORT
	int "CoAP server port"
	default 5715	#Signetik-IoT

endmenu

menu "Zephyr Kernel"
source "$ZEPHYR_BASE/Kconfig.zephyr"
endmenu
```

## prj.conf
```kconfig
# /*============================================================================*
#  *         Copyright © 2019-2020 Signetik, LLC -- All Rights Reserved         *
#  *----------------------------------------------------------------------------*
#  *                                                              Signetik, LLC *
#  *                                                           www.signetik.com *
#  *                                      SPDX-License-Identifier: BSD-4-Clause *
#  *============================================================================*/
#
# General config
CONFIG_TEST_RANDOM_GENERATOR=y
CONFIG_HEAP_MEM_POOL_SIZE=4096

# Networking
CONFIG_NETWORKING=y
#CONFIG_NET_NATIVE=n
CONFIG_NET_SOCKETS_OFFLOAD=y
CONFIG_NET_SOCKETS=y
CONFIG_NET_SOCKETS_POSIX_NAMES=y
#CONFIG_TINYCBOR=y

# Disable native network stack to save some memory
CONFIG_NET_IPV4=n
CONFIG_NET_IPV6=n
CONFIG_NET_UDP=n
CONFIG_NET_TCP=n

# LTE link control
CONFIG_LTE_LINK_CONTROL=y
CONFIG_LTE_AUTO_INIT_AND_CONNECT=n
CONFIG_LTE_NETWORK_USE_FALLBACK=y
CONFIG_LTE_NETWORK_TIMEOUT=120

# BSD library
CONFIG_BSD_LIBRARY=y
CONFIG_BSD_LIBRARY_TRACE_ENABLED=n

# AT Host
CONFIG_UART_INTERRUPT_DRIVEN=y
CONFIG_AT_HOST_LIBRARY=y

# CoAP
CONFIG_COAP=y

# Main thread
CONFIG_MAIN_STACK_SIZE=4096

# Devices
CONFIG_SERIAL=y
CONFIG_UART_CONSOLE_ON_DEV_NAME="UART_1"
CONFIG_UART_1_NRF_UARTE=y
CONFIG_STDOUT_CONSOLE=y
CONFIG_UART_INTERRUPT_DRIVEN=y
CONFIG_I2C=y
CONFIG_GPIO=y

# Sensors
CONFIG_SENSOR=y
CONFIG_LIS3DH=y
CONFIG_HTU21D=y

CONFIG_LOG=y
# CONFIG_LOG_MINIMAL is not set
# CONFIG_LOG_RUNTIME_FILTERING is not set
CONFIG_LOG_DEFAULT_LEVEL=3
CONFIG_LOG_OVERRIDE_LEVEL=0
CONFIG_LOG_MAX_LEVEL=4

# SNTP
CONFIG_SNTP=y
CONFIG_SNTP_LOG_LEVEL=0
```

## overlay-carrier.conf
```kconfig
# /*============================================================================*
#  *         Copyright © 2019-2020 Signetik, LLC -- All Rights Reserved         *
#  *----------------------------------------------------------------------------*
#  *                                                              Signetik, LLC *
#  *                                                           www.signetik.com *
#  *                                      SPDX-License-Identifier: BSD-4-Clause *
#  *============================================================================*/
#

CONFIG_LWM2M_CARRIER=y

# The library requires newlibc
CONFIG_NEWLIB_LIBC=y

CONFIG_BSD_LIBRARY=y
CONFIG_BSD_LIBRARY_SYS_INIT=n

# LTE link control
CONFIG_LTE_LINK_CONTROL=y
# Disable autoconnect
CONFIG_LTE_AUTO_INIT_AND_CONNECT=n

# Download client for DFU
CONFIG_DOWNLOAD_CLIENT=y
CONFIG_DOWNLOAD_CLIENT_TLS=y

# PDN management support
CONFIG_PDN_MANAGEMENT=y

# AT Command driver interface with Modem
CONFIG_AT_CMD=y
CONFIG_AT_CMD_PARSER=y

# Non-volatile Storage
CONFIG_FLASH=y
CONFIG_FLASH_PAGE_LAYOUT=y
CONFIG_NVS=y
CONFIG_MPU_ALLOW_FLASH_WRITE=y

# Heap and stacks
CONFIG_HEAP_MEM_POOL_SIZE=16384

# General config
CONFIG_NETWORKING=y
CONFIG_NET_SOCKETS=y
CONFIG_NET_SOCKETS_OFFLOAD=y
```

## src/main.c
```c
/*============================================================================*
 *         Copyright © 2019-2020 Signetik, LLC -- All Rights Reserved         *
 *----------------------------------------------------------------------------*
 *                                                              Signetik, LLC *
 *                                                           www.signetik.com *
 *                                      SPDX-License-Identifier: BSD-4-Clause *
 *============================================================================*/

#include <stdio.h>
#include <string.h>

#include <zephyr.h>
#include <net/coap.h>
#include <net/socket.h>
#include <lte_lc.h>

#include <sensor.h>
#include <drivers/gpio.h>
#include <drivers/regulator.h>

void main(void)
{
    struct device *led_en, *led_red, *led_grn, *led_blu;
    struct device *reg;

#if defined(DT_ALIAS_LEDEN_GPIOS_CONTROLLER) && defined(DT_ALIAS_LEDR_GPIOS_CONTROLLER)
    led_en = device_get_binding(DT_ALIAS_LEDEN_GPIOS_CONTROLLER);
    led_red = device_get_binding(DT_ALIAS_LEDR_GPIOS_CONTROLLER);
    led_grn = device_get_binding(DT_ALIAS_LEDG_GPIOS_CONTROLLER);
    led_blu = device_get_binding(DT_ALIAS_LEDB_GPIOS_CONTROLLER);

    gpio_pin_configure(led_en, DT_ALIAS_LEDEN_GPIOS_PIN, GPIO_DIR_OUT);
    gpio_pin_configure(led_red, DT_ALIAS_LEDR_GPIOS_PIN, GPIO_DIR_OUT);
    gpio_pin_configure(led_grn, DT_ALIAS_LEDG_GPIOS_PIN, GPIO_DIR_OUT);
    gpio_pin_configure(led_blu, DT_ALIAS_LEDB_GPIOS_PIN, GPIO_DIR_OUT);

    gpio_pin_write(led_en, DT_ALIAS_LEDEN_GPIOS_PIN, 0);
    gpio_pin_write(led_red, DT_ALIAS_LEDR_GPIOS_PIN, 0);
    gpio_pin_write(led_grn, DT_ALIAS_LEDG_GPIOS_PIN, 1);
    gpio_pin_write(led_blu, DT_ALIAS_LEDB_GPIOS_PIN, 0);
#endif

#if defined(CONFIG_REGULATOR)
    reg = device_get_binding("lsensor_reg");
    if (reg) {
#if !defined(CONFIG_REGULATOR_ALWAYSON)
        regulator_disable(reg);
#endif
    }
#endif
}
```

## src/LTE_task.c
```c
/*============================================================================*
 *         Copyright © 2019-2020 Signetik, LLC -- All Rights Reserved         *
 *----------------------------------------------------------------------------*
 *                                                              Signetik, LLC *
 *                                                           www.signetik.com *
 *                                      SPDX-License-Identifier: BSD-4-Clause *
 *============================================================================*/

#include <stdio.h>
#include <string.h>

#include <zephyr.h>
#include <net/coap.h>
#include <net/socket.h>
#include <fcntl.h>
#include <lte_lc.h>
#include <at_cmd.h>
#include <drivers/gpio.h>

#include <sensor.h>
#include <logging/log.h>

#include <net/sntp.h>

#include "signetik.h"
#include "LTE_task.h"
#include "accel_task.h"
#include "temp_humidity_task.h"

#include "cell_packet.h"
#include "coap_cbor_device.h"

LOG_MODULE_REGISTER(lte, LOG_LEVEL_DBG);

#define APP_COAP_SEND_INTERVAL_MS K_MSEC(5000)
#define APP_COAP_MAX_MSG_LEN 1280
#define APP_COAP_VERSION 1

bool LTE_ready = false;
static int sock;
static struct pollfd fds;
static struct sockaddr_storage server;
static u16_t next_token;

bool send1 = false;

static int record_number = 0, record_count = 0;
s64_t base_time = 0;

K_SEM_DEFINE(sem_lte, 0, 1);
K_SEM_DEFINE(sem_lte_complete, 0, 1);

static int lte_result;

void LTE_send(int rn, int rc)
{
	record_number = rn;
	record_count = rc;
	k_sem_give(&sem_lte);
}

int LTE_wait_complete(void)
{
	k_sem_take(&sem_lte_complete, K_FOREVER);
	return lte_result;
}

#if defined(CONFIG_BSD_LIBRARY)

/**@brief Recoverable BSD library error. */
void bsd_recoverable_error_handler(uint32_t err)
{
	printk("bsdlib recoverable error: %u\n", err);
}
bool cellular_ready(void)
{
	return LTE_ready;
}
/**@brief Irrecoverable BSD library error. */
void bsd_irrecoverable_error_handler(uint32_t err)
{
	printk("bsdlib irrecoverable error: %u\n", err);

	__ASSERT_NO_MSG(false);
}

#endif /* defined(CONFIG_BSD_LIBRARY) */

/**@brief Resolves the configured hostname. */
static int server_resolve(void)
{
	int err;
	struct addrinfo *result;
	struct addrinfo hints = {
		.ai_family = AF_INET,
		.ai_socktype = SOCK_DGRAM
	};
	char ipv4_addr[NET_IPV4_ADDR_LEN];

	err = getaddrinfo(CONFIG_COAP_SERVER_HOSTNAME, NULL, &hints, &result);
	if (err != 0) {
		LOG_ERR("getaddrinfo failed %d", err);
		return -EIO;
	}

	if (result == NULL) {
		LOG_ERR("Address not found");
		return -ENOENT;
	}

	/* IPv4 Address. */
	struct sockaddr_in *server4 = ((struct sockaddr_in *)&server);

	server4->sin_addr.s_addr =
		((struct sockaddr_in *)result->ai_addr)->sin_addr.s_addr;
	server4->sin_family = AF_INET;
	server4->sin_port = htons(CONFIG_COAP_SERVER_PORT);

	inet_ntop(AF_INET, &server4->sin_addr.s_addr, ipv4_addr,
			sizeof(ipv4_addr));
	LOG_INF("IPv4 Address found %s", log_strdup(ipv4_addr));

	/* Free the address. */
	freeaddrinfo(result);

	return 0;
}

/**@brief Initialize the CoAP client */
static int client_init(void)
{
	int err;

	LOG_INF("Opening socket");
	sock = socket(AF_INET, SOCK_DGRAM, IPPROTO_UDP);
	if (sock < 0) {
		LOG_ERR("Failed to create CoAP socket: %d.", errno);
		return -errno;
	}

	int flags = fcntl(sock, F_GETFL, 0);
	fcntl(sock, F_SETFL, flags | O_NONBLOCK);

	LOG_INF("Connecting");
	err = connect(sock, (struct sockaddr *)&server,
			sizeof(struct sockaddr_in));
	if (err < 0) {
		if (errno != EINPROGRESS) {
			LOG_ERR("Connect failed : %d", errno);
			close(sock);
			return -errno;
		}
		else {
			LOG_INF("Connection in progress.");
		}
	}

	/* Initialize FDS, for poll. */
	fds.fd = sock;
	fds.events = POLLOUT;

	/* Randomize token. */
	next_token = sys_rand32_get();

	return 0;
}

/**@brief Handles responses from the remote CoAP server. */
static int client_handle_get_response(u8_t *buf, int received)
{
	int err;
	struct coap_packet reply;
	const u8_t *payload;
	u16_t payload_len;
	u8_t token[8];
	u16_t token_len;
	u8_t temp_buf[16];

	err = coap_packet_parse(&reply, buf, received, NULL, 0);
	if (err < 0) {
		LOG_ERR("Malformed response received: %d", err);
		return err;
	}

	payload = coap_packet_get_payload(&reply, &payload_len);
	//	token_len = coap_header_get_token(&reply, token);

	//	if ((token_len != sizeof(next_token)) &&
	//	    (memcmp(&next_token, token, sizeof(next_token)) != 0)) {
	//		printk("Invalid token received: 0x%02x%02x\n",
	//		       token[1], token[0]);
	//		return 0;
	//	}

	snprintf(temp_buf, MIN(payload_len, sizeof(temp_buf)), "%s", payload);
	LOG_INF("CoAP response: code: 0x%x, token 0x%02x%02x, payload: %s",
			coap_header_get_code(&reply), token[1], token[0], log_strdup(temp_buf));
	//        u8_t temp_buf1[16];
	//	snprintf(temp_buf1, sizeof(token) - 2, "%s", token[2]);
	//
	//	printk("CoAP response: code: 0x%x, token 0x%02x%02x : %d - %s - payload: %s\n",
	//	       coap_header_get_code(&reply), token[1], token[0], token_len, temp_buf1, temp_buf);

	return 0;
}

static inline bool append_u8(struct coap_packet *cpkt, u8_t data)
{
	if (!cpkt) {
		return false;
	}

	if (cpkt->max_len - cpkt->offset < 1) {
		return false;
	}

	cpkt->data[cpkt->offset++] = data;

	return true;
}

/**@biref Send CoAP GET request. */
int client_get_send(uint8_t *buffer, size_t length)
{
	int err;

	err = send(sock, buffer, length, 0);
	if (err < 0) {
		LOG_ERR("Failed to send CoAP request, %d", errno);
		return -errno;
	}

	LOG_INF("CoAP request sent: %d bytes", length);

	return 0;
}

void system_configure(void)
{
	static u8_t at_buff[40];
#if(1)
	enum at_cmd_state at_state;
	// Check IMEI
	int error = at_cmd_write("AT+CGSN", at_buff, sizeof(at_buff), &at_state);
	if (error) {
		LOG_ERR("Error when trying to do at_cmd_write: %d, at_state: %d\n\n", error, at_state);
		//            return 0;
	}
	else {
		LOG_INF("IMEI: %s", log_strdup(at_buff));
	}

	/*      The following may be needed to register with Verizon network (https://www.multitech.com/documents/publications/activation-guides/verizon-wireless-activation-procedure-for-mvw1-devices.pdf) */

#if(0)
	// Check if device registered
	char ceregBuff[1024];
	error = at_cmd_write("AT+CEREG?", ceregBuff, sizeof(ceregBuff), &at_state);
	if (error) {
		printk("Error when trying to do at_cmd_write: %d, at_state: %d\n\n", error, at_state);
		//            return 0;
	}
	else {
		printk("registered: %s", ceregBuff);
		printk("Should be \"+CEREG:0,1\" OR \"+CEREG:0,5\"\n\n");
	}
#endif

	// Check APN recieved
	error = at_cmd_write("AT+CGCONT", at_buff, sizeof(at_buff), &at_state);
	if (error) {
		LOG_ERR("Error when trying to do at_cmd_write: %d, at_state: %d", error, at_state);
		//            return 0;
	}
	else {
		LOG_INF("APN: %s", log_strdup(at_buff));
		LOG_INF("Should be \"1,5,vzwinternet,...\"");
	}
#if(0)
	// Set PDP context
	error = at_cmd_write("AT+CGDCONT=3,\"IPV4V6\",\"VZWINTERNET\"\r\n", NULL, 0, &at_state);
	if (error) {
		printk("Error when trying to do at_cmd_write: %d, at_state: %d\n\n", error, at_state);
		//            return 0;
	}
#endif
#endif
}

static void get_sntp_time(void)
{
	struct sntp_time time;
	int result;

	result = sntp_simple("time.google.com", 10000, &time);

	if (result == 0) {
		uint32_t ms;
		LOG_INF("SNTP time: %d:%u", (uint32_t)time.seconds, time.fraction);
		ms = ((time.fraction / (1<<10)) * 1000) / (1<<22);
		LOG_INF("SNTP time: %d.%03d", (uint32_t)time.seconds, ms);
		base_time = ((s64_t)time.seconds)*1000 + ms;
		base_time -= k_uptime_get();
		LOG_INF("SNTP base_time: %d%03d", (s32_t)(base_time/1000), (s32_t)(base_time%1000));
	}
}

/**@brief Configures modem to provide LTE link. Blocks until link is
 * successfully established.
 */
static int modem_configure(void)
{

#if defined(CONFIG_LTE_LINK_CONTROL)
	if (IS_ENABLED(CONFIG_LTE_AUTO_INIT_AND_CONNECT)) {
		/* Do nothing, modem is already turned on
		 * and connected.
		 */
	} else {
		int err;

		LOG_INF("LTE Link Connecting...");
		err = lte_lc_init_and_connect();
		if (err != 0) {
			LOG_ERR("Failed LTE init and connect (%d)", err);
			return err;
		}
		LOG_INF("LTE Link Connected!");
		LTE_ready = true;
		LOG_INF("Entering--->>> LTE Link Power saving mode");
		err = lte_lc_psm_req(true);
		if (err == 0)
			LOG_INF("LTE Link power saving enabled!");
		else
			LOG_INF("LTE Link power saving NOT enabled!");
	}
#endif

	if (base_time == 0) {
		get_sntp_time();
	}
	return 0;
}
/**@brief Configures modem to provide LTE link. Blocks until link is
 * successfully established.
 */
static void modem_poweroff(void)
{

#if defined(CONFIG_LTE_LINK_CONTROL)
	if (IS_ENABLED(CONFIG_LTE_AUTO_INIT_AND_CONNECT)) {
		/* Do nothing, modem is already turned on
		 * and connected.
		 */
	} else {
		int err;

		LOG_INF("LTE Link powering off...");
		err = lte_lc_power_off();
		if (err != 0) {
			LOG_ERR("LTE link could not be powered off.");
		}
		else {
			LOG_INF("LTE Link is powered off!");
		}
		LTE_ready = false;

	}
#endif
}


/* Returns 0 if data is available.
 * Returns -EAGAIN if timeout occured and there is no data.
 * Returns other, negative error code in case of poll error.
 */
static int wait(int timeout)
{
	int ret;

	LOG_DBG("Waiting on socket %d for %d ms.", fds.fd, timeout);

	ret = poll(&fds, 1, timeout);

	LOG_DBG("Socket wait completed.");

	if (ret < 0) {
		LOG_ERR("poll error: %d", errno);
		return -errno;
	}

	if (ret == 0) {
		/* Timeout. */
		LOG_DBG("Socket wait timed out after %d ms.", timeout);
		return -EAGAIN;
	}

	if ((fds.revents & POLLERR) == POLLERR) {
		LOG_ERR("wait: POLLERR");
		return -EIO;
	}

	if ((fds.revents & POLLNVAL) == POLLNVAL) {
		LOG_ERR("wait: POLLNVAL");
		return -EBADF;
	}

	if ((fds.revents & (POLLIN | POLLOUT)) == 0) {
		LOG_DBG("Socket event failed after %d ms.", timeout);
		return -EAGAIN;
	}

	return 0;
}
//void app_timer1_handler(struct k_timer *dummy)
//{
//	static u32_t minutes = 0;
//
//	minutes++;
//        printk("Sleeping time: %d\n", minutes);
//	/* This shall match the PSM interval */
//	if (minutes % 5 == 0) {
//            LTE_wake = true;
//            minutes = 0;
//	}
//}
//void app_timer2_handler(struct k_timer *dummy)
//{
//	static u32_t minutes = 0;
//
//	minutes++;
//	/* This shall match the PSM interval */
//	if (minutes % 1 == 0) {
//		  = false;
//	}
//	printk("Waken time: %d\n", minutes);
//}

//K_TIMER_DEFINE(app_timer1, app_timer1_handler, NULL);
//K_TIMER_DEFINE(app_timer2, app_timer2_handler, NULL);

//void timer1_stop(void)
//{
//	k_timer_stop(&app_timer1);
//}
//void timer2_init(void)
//{
//	k_timer_start(&app_timer2, K_MINUTES(1), K_MINUTES(1));
//}
//void timer2_stop(void)
//{
//	k_timer_stop(&app_timer2);
//}



void LTE_thread(void)
{
	int err;

	//    k_sem_init(&new_settings, 0, 1);
#if(0)
	struct device *d;
	d = device_get_binding("GPIO_0");
	gpio_pin_configure(d, 11, GPIO_DIR_OUT);
	gpio_pin_write(d, 11, 1);
#endif

	system_configure();

	err = modem_configure();

	if (err != 0) {
		LOG_ERR("LTE failed to connect (%d) for SNTP.", err);
	}

	while(1){
		k_sem_give(&sem_lte_complete);
		modem_poweroff();
		k_sem_take(&sem_lte, K_FOREVER);

		lte_result = -ECONNABORTED;

		int received;
		LOG_INF("Starting modem.");

		err = modem_configure();

		if (err != 0) {
			LOG_ERR("LTE failed to connect (%d).", err);
			continue;
		}

		if (server_resolve() != 0) {
			LOG_ERR("Failed to resolve server name");
			continue;
		}

		if (client_init() != 0) {
			LOG_ERR("Failed to initialize CoAP client");
			continue;
		}

		static u8_t coap_buf[APP_COAP_MAX_MSG_LEN];

		static uint8_t   COAP_buff[APP_COAP_MAX_MSG_LEN];
		uint8_t * COAP_buff_ptr = &COAP_buff[0];
		size_t   COAP_buff_len = sizeof(COAP_buff);
		int retry = 3;

		LOG_INF("Waiting for connect.");
		if (wait(15000) != 0) {
			LOG_INF("Failed to connect.");
			retry = 0;
		}

		create_coap_cbor_with_packet_def(&sig_tha_packet_def, DEVICE_ID, record_number, record_count, &COAP_buff_ptr, &COAP_buff_len);
		while (retry)
		{
			retry--;
			LOG_DBG("Sending request %d-%p-%d.", sock, COAP_buff_ptr, COAP_buff_len);

			k_sleep(100); // socket "send" crashes no delay between connect and send.
			if (client_get_send(COAP_buff_ptr, COAP_buff_len) != 0)
			{
				LOG_ERR("Failed to send GET request.");
				break;
			}

			int error = EAGAIN;
			int timeout = 15000;
			while (((error == EAGAIN) || (error == EWOULDBLOCK)) && (timeout > 0)) {
				LOG_DBG("Receiving response.");
				received = recv(sock, coap_buf, sizeof(coap_buf), 0);
				LOG_DBG("Receive result %d", received);
				if (received < 0) {
					error = errno;
					if (error == EAGAIN || error == EWOULDBLOCK) {
						LOG_INF("socket EAGAIN");
						k_sleep(100);
						timeout -= 100;
						continue;
					} 
					else {
						LOG_ERR("Socket error %d.", error);
						break;
					}
				}
				else {
					error = 0;
				}
			}

			if (error == 0) {
				if (received == 0) {
					LOG_ERR("Empty datagram");
					continue;
				}
				LOG_DBG("Parse response");
				err = client_handle_get_response(coap_buf, received);
				if (err < 0) {
					LOG_ERR("Invalid response.");
					break;
				}
				else {
					LOG_DBG("Response good");
					retry = 0;
					lte_result = 0;
				}
			}
		}
		LOG_DBG("Closing socket");
		(void)close(sock);
	}
}

// LTE thread
K_THREAD_DEFINE(LTE_id, LTE_STACKSIZE, LTE_thread, NULL, NULL, NULL,
                LTE_PRIORITY, K_FP_REGS, K_NO_WAIT);
```

## src/LTE_task.h
```c
/*============================================================================*
 *         Copyright © 2019-2020 Signetik, LLC -- All Rights Reserved         *
 *----------------------------------------------------------------------------*
 *                                                              Signetik, LLC *
 *                                                           www.signetik.com *
 *                                      SPDX-License-Identifier: BSD-4-Clause *
 *============================================================================*/

#define DEVICE_ID 0xC0000003
extern uint8_t * COAP_buff_ptr;
extern uint32_t COAP_buff_len;
extern s64_t base_time;

_Bool cellular_ready(void);
void LTE_thread(void);
void LTE_send(int rn, int rc);
int LTE_wait_complete(void);
```

## src/accel_task.c
```c
/*============================================================================*
 *         Copyright © 2019-2020 Signetik, LLC -- All Rights Reserved         *
 *----------------------------------------------------------------------------*
 *                                                              Signetik, LLC *
 *                                                           www.signetik.com *
 *                                      SPDX-License-Identifier: BSD-4-Clause *
 *============================================================================*/

#include <stdio.h>
#include <string.h>

#include <zephyr.h>
#include <sensor.h>
#include <drivers/regulator.h>
#include <logging/log.h>

#include "signetik.h"
#include "accel_task.h"
#include "cell_packet.h"

LOG_MODULE_REGISTER(acc, LOG_LEVEL_INF);

////////////LIS3DH
static bool accel_data_ready;
K_SEM_DEFINE(sem_accel, 0, 1);

static struct sensor_value x_value;
static struct sensor_value y_value;
static struct sensor_value z_value;

void accel_start(void)
{
    accel_data_ready = false;
    k_sem_give(&sem_accel);
}


bool accel_ready(void)
{
    return accel_data_ready;
}

void accel_get_data(uint32_t *x, uint32_t *y, uint32_t *z)
{
	*x = x_value.val2;
	*y = y_value.val2;
	*z = z_value.val2;
}

void read_lis3dh(struct device *dev)
{
    int ret;
    //    struct sensor_value XYZ_value;

    while (1)
    {
        //	struct sensor_value attr;
        //
        //	attr.val1 = 150;
        //	attr.val2 = 0;
        //	ret = sensor_attr_set(dev, SENSOR_CHAN_AMBIENT_TEMP,
        //			      SENSOR_ATTR_FULL_SCALE, &attr);
        //	if (ret) {
        //		printk("sensor_attr_set failed ret %d\n", ret);
        //		return;
        //	}
        //
        //	attr.val1 = 8;
        //	attr.val2 = 0;
        //	ret = sensor_attr_set(dev, SENSOR_CHAN_AMBIENT_TEMP,
        //			      SENSOR_ATTR_SAMPLING_FREQUENCY, &attr);
        //	if (ret) {
        //		printk("sensor_attr_set failed ret %d\n", ret);
        //		return;
        //	}

        k_sleep(1000);
        k_sem_take(&sem_accel, K_FOREVER);

        x_value.val1 = y_value.val1 = z_value.val1 = 0;
        x_value.val2 = y_value.val2 = z_value.val2 = 0;
        if (dev) {
#if defined(CONFIG_REGULATOR)
            struct device *reg;

            reg = device_get_binding("lsensor_reg");
            if (reg) {
#if !defined(CONFIG_REGULATOR_ALWAYSON)
                regulator_enable(reg);
#endif
            }
#endif

            ret = sensor_sample_fetch(dev);
            if (ret)
            {
                LOG_ERR("sensor_sample_fetch failed ret %d", ret);
            }

            ret = sensor_channel_get(dev, SENSOR_CHAN_ACCEL_X, &x_value);
            if (ret)
            {
                LOG_ERR("sensor_channel_get failed ret %d", ret);
            }

            ret = sensor_channel_get(dev, SENSOR_CHAN_ACCEL_Y, &y_value);
            if (ret)
            {
                LOG_ERR("sensor_channel_get failed ret %d", ret);
            }

            ret = sensor_channel_get(dev, SENSOR_CHAN_ACCEL_Z, &z_value);
            if (ret)
            {
                LOG_ERR("sensor_channel_get failed ret %d", ret);
            }

#if defined(CONFIG_REGULATOR)
            if (reg) {
#if !defined(CONFIG_REGULATOR_ALWAYSON)
                regulator_disable(reg);
#endif
            }
#endif
        }

        //            ret = sensor_channel_get(dev, SENSOR_CHAN_ACCEL_XYZ, &XYZ_value);
        //            if (ret)
        //            {
        //                printk("sensor_channel_get failed ret %d\n", ret);
        //                continue;
        //            }

        accel_data_ready = true;

        if (accel_data_ready == true)
        {
			// TODO: This ^ match is not right
            LOG_INF("Accel data ready, X=%d, Y=%d, Z=%d",
				x_value.val1 + (x_value.val2*(10^(-6))),
				y_value.val1 + (y_value.val2*(10^(-6))),
				z_value.val1 + (z_value.val2*(10^(-6))));
        }
    }
}

void accel_thread(void)
{
    struct device *dev;

    dev = device_get_binding("LIS3DH");
    LOG_INF("ACC thread, device is %p, name is %s", dev, dev ? dev->config->name : "NOTFOUND");

    read_lis3dh(dev);
}

#ifdef CONFIG_LIS3DH
K_THREAD_DEFINE(accel_id, ACCEL_STACKSIZE, accel_thread, NULL, NULL, NULL,
		ACCEL_PRIORITY, K_FP_REGS, K_NO_WAIT);
#endif //CONFIG_LIS3DH
```

## src/accel_task.h
```c
/*============================================================================*
 *         Copyright © 2019-2020 Signetik, LLC -- All Rights Reserved         *
 *----------------------------------------------------------------------------*
 *                                                              Signetik, LLC *
 *                                                           www.signetik.com *
 *                                      SPDX-License-Identifier: BSD-4-Clause *
 *============================================================================*/

void accel_start(void);
bool accel_ready(void);
void accel_get_data(uint32_t *x, uint32_t *y, uint32_t *z);
```

## src/cell_packet.c
```c
/*============================================================================*
 *         Copyright © 2019-2020 Signetik, LLC -- All Rights Reserved         *
 *----------------------------------------------------------------------------*
 *                                                              Signetik, LLC *
 *                                                           www.signetik.com *
 *                                      SPDX-License-Identifier: BSD-4-Clause *
 *============================================================================*/

#include "cell_packet.h"
#include <zephyr.h>

K_SEM_DEFINE(sem_data, 1, 1);

#if(0)
cell_packet_def_t sigcfg_packet_def [5];

const cell_packet_def_t sig_gps_packet_def = 
{
	.packet_name	= "gps_tracker",
	.product_type	= "HSS",
	.num_fields		= 6,
	.field[0].name	= "lat",
	.field[0].ftype	= CBOR_FLOAT_REVERSE,
	.field[0].data	= (void *) &gps_packet.lat,
	.field[1].name	= "lon",
	.field[1].ftype	= CBOR_FLOAT_REVERSE,
	.field[1].data	= (void *) &gps_packet.lon,
	.field[2].name	= "alt_m",
	.field[2].ftype	= CBOR_FLOAT_REVERSE,
	.field[2].data	= (void *) &gps_packet.alt_m,
	.field[3].name	= "HDOP",
	.field[3].ftype	= CBOR_FLOAT_REVERSE,
	.field[3].data	= (void *) &gps_packet.HDOP,
	.field[4].name	= "num_sat",
	.field[4].ftype	= CBOR_INT8,
	.field[4].data	= (void *) &gps_packet.num_sat,
	.field[5].name	= "distance_m",
	.field[5].ftype	= CBOR_INT32,
	.field[5].data	= (void *) &gps_packet.distance_m,
};
#endif

#define MAX_RECORDS 24
struct tha_packet_storage_s 
{
	uint32_t ts_s[MAX_RECORDS];
	uint32_t ts_ms[MAX_RECORDS];
	int32_t x[MAX_RECORDS];
	int32_t y[MAX_RECORDS];
	int32_t z[MAX_RECORDS];
	int32_t temperature[MAX_RECORDS];
	int32_t humidity[MAX_RECORDS];
};

struct tha_packet_storage_s tha_packet = { 0 };

int sig_tha_set_data( struct tha_packet_s *data, int index )
{
	if (index >= MAX_RECORDS)
		return -1;
    if (k_sem_take(&sem_data, 10000) != 0)
    {
        printk("Packet data in use, not setting.\n");
        return -1;
    }
	tha_packet.ts_s[index] = data->ts_s;
	tha_packet.ts_ms[index] = data->ts_ms;
    tha_packet.x[index] = data->x;
    tha_packet.y[index] = data->y;
    tha_packet.z[index] = data->z;
	tha_packet.temperature[index] = data->temperature;
	tha_packet.humidity[index] = data->humidity;
    k_sem_give(&sem_data);

	return 0;
}


const cell_packet_def_t sig_tha_packet_def =
{
    .packet_name	= "THA_Data",
    .product_type	= "SIGTHA",
	.ts_s           = tha_packet.ts_s,
	.ts_ms          = tha_packet.ts_ms,
    .num_fields     = 5,
    .field[0].name	= "x_rms",
    .field[0].ftype	= CBOR_INT32,
    .field[0].data	= (void *) tha_packet.x,
    .field[1].name	= "y_rms",
    .field[1].ftype	= CBOR_INT32,
    .field[1].data	= (void *) tha_packet.y,
    .field[2].name	= "z_rms",
    .field[2].ftype	= CBOR_INT32,
    .field[2].data	= (void *) tha_packet.z,
    .field[3].name	= "temp_c",
    .field[3].ftype	= CBOR_INT32,
    .field[3].data	= (void *) tha_packet.temperature,	
    .field[4].name  = "humidity",
    .field[4].ftype	= CBOR_INT32,
    .field[4].data	= (void *) tha_packet.humidity,
};
```

## src/cell_packet.h
```c
/*============================================================================*
 *         Copyright © 2019-2020 Signetik, LLC -- All Rights Reserved         *
 *----------------------------------------------------------------------------*
 *                                                              Signetik, LLC *
 *                                                           www.signetik.com *
 *                                      SPDX-License-Identifier: BSD-4-Clause *
 *============================================================================*/

#include <stdint.h>

#ifndef CELL_PACKET_H_
#define CELL_PACKET_H_

enum cbor_data_type
{
	CBOR_ERROR = 0,
	CBOR_INT8,
	CBOR_INT16,
	CBOR_INT32,
	CBOR_RAW,
	CBOR_TEXT,
	CBOR_FLOAT,
	CBOR_FLOAT_REVERSE,
	CBOR_DOUBLE,
	CBOR_BOOL,
};

typedef struct packet_field_s
{
	uint8_t name[32];
	enum cbor_data_type ftype;
	void * data;
	
}cell_packet_field_t;

typedef const struct cell_packet_def_s
{
	uint32_t *ts_s;
	uint32_t *ts_ms;
	uint8_t packet_name[32];
	uint8_t product_type[32];
	uint8_t num_fields;
	cell_packet_field_t field [10];
		
}cell_packet_def_t;

struct tha_packet_s 
{
	uint32_t ts_s;
	uint32_t ts_ms;
	int32_t x;
	int32_t y;
	int32_t z;
	int32_t temperature;
	int32_t humidity;
};

int sig_tha_set_data( struct tha_packet_s *data, int index );

extern const cell_packet_def_t sig_gps_packet_def;
extern const cell_packet_def_t sig_tha_packet_def;
extern cell_packet_def_t sigcfg_packet_def [5];

#endif /* CELL_PACKET_H_ */
```

## src/coap_cbor_device.h
```c
/*============================================================================*
 *         Copyright © 2019-2020 Signetik, LLC -- All Rights Reserved         *
 *----------------------------------------------------------------------------*
 *                                                              Signetik, LLC *
 *                                                           www.signetik.com *
 *                                      SPDX-License-Identifier: BSD-4-Clause *
 *============================================================================*/

#ifndef _COAP_CBOR_DEVICE_H_
#define _COAP_CBOR_DEVICE_H_

#include <stdint.h>
#include <stdbool.h>
//#include <stddef.h>
#include "cell_packet.h"
#include "sigconfig.h"

#ifdef __cplusplus
extern "C" {
#endif
void create_coap_cbor_with_sigcfg(sigconfig_master_t * sigcfg, uint8_t group, uint32_t device_id, int record_number, int num_reports, uint8_t **coap_buf, uint32_t *coap_len);
void create_coap_cbor_with_packet_def(cell_packet_def_t * packet_def, uint32_t device_id, int record_number, int num_reports, uint8_t **coap_buf, uint32_t *coap_len);
void create_config_request(uint32_t device_id, uint8_t need_settings, uint8_t **coap_buf, uint32_t *coap_len);
int extract_binary_from_coap_cbor(uint8_t *coap, uint16_t coap_len, uint8_t *payload, uint16_t payload_len);

#ifdef __cplusplus
}
#endif

#endif
```

## src/main_task.c
```c
/*============================================================================*
 *         Copyright © 2019-2020 Signetik, LLC -- All Rights Reserved         *
 *----------------------------------------------------------------------------*
 *                                                              Signetik, LLC *
 *                                                           www.signetik.com *
 *                                      SPDX-License-Identifier: BSD-4-Clause *
 *============================================================================*/

#include <stdio.h>
#include <string.h>

#include <zephyr.h>
#include <net/coap.h>
#include <net/socket.h>
#include <fcntl.h>
#include <lte_lc.h>
#include <at_cmd.h>
#include <drivers/gpio.h>

#include <sensor.h>
#include <logging/log.h>

#include "signetik.h"
#include "LTE_task.h"
#include "accel_task.h"
#include "temp_humidity_task.h"

#include "cell_packet.h"
#include "coap_cbor_device.h"

LOG_MODULE_REGISTER(main, LOG_LEVEL_DBG);

static void go_to_sleep(int ms);

void main_thread(void)
{
	struct device *led_en, *led_r, *led_g, *led_b;
	s64_t next_time = k_uptime_get() + 5000;
	int sleep_duration;
	const int sensor_interval = 1000 * 60;
	const int modem_rate = 5;
	int record_number = 1;
	int sample_number = 0;
	struct tha_packet_s tha_data;
	int result;

#if defined(DT_ALIAS_LEDEN_GPIOS_CONTROLLER)
	led_en = device_get_binding(DT_ALIAS_LEDEN_GPIOS_CONTROLLER);
	led_r = device_get_binding(DT_ALIAS_LEDR_GPIOS_CONTROLLER);
	led_g = device_get_binding(DT_ALIAS_LEDG_GPIOS_CONTROLLER);
	led_b = device_get_binding(DT_ALIAS_LEDB_GPIOS_CONTROLLER);
	gpio_pin_configure(led_en, DT_ALIAS_LEDEN_GPIOS_PIN, GPIO_DIR_OUT);
	gpio_pin_configure(led_r, DT_ALIAS_LEDR_GPIOS_PIN, GPIO_DIR_OUT);
	gpio_pin_configure(led_g, DT_ALIAS_LEDG_GPIOS_PIN, GPIO_DIR_OUT);
	gpio_pin_configure(led_b, DT_ALIAS_LEDB_GPIOS_PIN, GPIO_DIR_OUT);
#endif

	LTE_wait_complete();

	while(1) {
#if defined(DT_ALIAS_LEDEN_GPIOS_CONTROLLER)
		gpio_pin_write(led_en, DT_ALIAS_LEDEN_GPIOS_PIN, 1);
		gpio_pin_write(led_r, DT_ALIAS_LEDR_GPIOS_PIN, 1);
		gpio_pin_write(led_g, DT_ALIAS_LEDG_GPIOS_PIN, 1);
		gpio_pin_write(led_b, DT_ALIAS_LEDB_GPIOS_PIN, 1);
#endif
		sleep_duration = next_time - k_uptime_get();
		if (sleep_duration > sensor_interval)
			sleep_duration = sensor_interval;
		if ((sleep_duration * modem_rate) < 60000)
			sleep_duration = 60000 / modem_rate;
		LOG_INF("Sleeping for %d milliseconds (%lu,%lu).", sleep_duration, (long)next_time, (long)k_uptime_get());
		go_to_sleep(sleep_duration);

#if defined(DT_ALIAS_LEDEN_GPIOS_CONTROLLER)
		gpio_pin_write(led_en, DT_ALIAS_LEDEN_GPIOS_PIN, 0);
		gpio_pin_write(led_r, DT_ALIAS_LEDR_GPIOS_PIN, 0);
		gpio_pin_write(led_b, DT_ALIAS_LEDB_GPIOS_PIN, 0);
#endif
		next_time += sensor_interval;

#ifdef CONFIG_LIS3DH
		accel_start();
#endif
#ifdef CONFIG_HTU21D
		temp_humid_start();
#endif

#if defined(DT_ALIAS_LEDEN_GPIOS_CONTROLLER)
		gpio_pin_write(led_r, DT_ALIAS_LEDR_GPIOS_PIN, 0);
		gpio_pin_write(led_b, DT_ALIAS_LEDB_GPIOS_PIN, 1);
#endif

		LOG_INF("Waiting for sensor data.");
		while (false
#ifdef CONFIG_LIS3DH
				|| !accel_ready()
#endif
#ifdef CONFIG_HTU21D
				|| !temp_humid_ready()
#endif
			  )
		{
			// TODO: Some timeout
			k_sleep(100);
		}

		LOG_INF("Storing sensor data (%d).", record_number + sample_number);
		accel_get_data(&tha_data.x, &tha_data.y, &tha_data.z);
		temp_humid_get_data(&tha_data.temperature, &tha_data.humidity);
		if (base_time != 0) {
			s64_t now = k_uptime_get() + base_time;
			tha_data.ts_s = (u32_t)(now / 1000);
			tha_data.ts_ms = (u32_t)(now % 1000);
		}
		else {
			tha_data.ts_s = 0;
			tha_data.ts_ms = 0;
		}
        sig_tha_set_data( &tha_data, sample_number++ );

		if (sample_number >= modem_rate) {
			LOG_INF("%d samples ready, starting connection.", modem_rate);

#if defined(DT_ALIAS_LEDEN_GPIOS_CONTROLLER)
			gpio_pin_write(led_r, DT_ALIAS_LEDR_GPIOS_PIN, 1);
			gpio_pin_write(led_b, DT_ALIAS_LEDB_GPIOS_PIN, 0);
#endif

			LTE_send(record_number, modem_rate);

			// wait and if success
			result = LTE_wait_complete();

			if (result == 0) {
				LOG_INF("Data sent to server. Updating stored data.");
				record_number += modem_rate;
			}
			else {
				LOG_ERR("Failed to send data. Dropping data.");
				// TODO: 
				record_number += modem_rate;
			}
			sample_number = 0;
		}

	}
}

static void go_to_sleep(int ms)
{
	//TODO: Don't sleep, use timer
	k_sleep(ms);
	//	k_timer_start(&app_timer1, K_MINUTES(1), K_MINUTES(1));
}


K_THREAD_DEFINE(main_id, MAIN_STACKSIZE, main_thread, NULL, NULL, NULL,
                MAIN_PRIORITY, K_FP_REGS, K_NO_WAIT);
```

## src/sigconfig.h
```c
/*============================================================================*
 *         Copyright © 2019-2020 Signetik, LLC -- All Rights Reserved         *
 *----------------------------------------------------------------------------*
 *                                                              Signetik, LLC *
 *                                                           www.signetik.com *
 *                                      SPDX-License-Identifier: BSD-4-Clause *
 *============================================================================*/

#include "coap_cbor_device.h"

#ifndef SIGCONFIG_H_
#define SIGCONFIG_H_


enum sigcfg_protocol
{
	PROTO_ERROR = 0,
	MODBUS,
	I2C,
	SPI,	
};

typedef struct modbus_transaction_s // objects in get array (should just be 1 for now)
{
	uint8_t slave_addr;
	uint8_t opcode;
	uint16_t reg_addr;
	uint16_t num;
	uint8_t * data_received;
} modbus_action_t;

typedef struct field_s //field
{
	enum sigcfg_protocol protocol;
	enum cbor_data_type type;
	uint8_t field_name [16];
	uint8_t num_actions;
	uint8_t * data;
	modbus_action_t action [5];	
}field_group_t;

typedef struct packet_s //packet
{
	uint8_t report_name [16];
	uint32_t sample_interval_s;
	uint32_t next_sample_time;
	uint32_t report_interval_s;
	uint8_t num_fields;
	field_group_t field [5];	
} packet_group_t;

typedef struct sigconfig_master_s
{
	uint8_t num_groups;
	packet_group_t packet [5];	
}sigconfig_master_t;

//typedef struct uart_settings_s
//{
//	uint32_t baud;
//	enum usart_parity parity;
//	enum usart_stopbits stop_bits;	
//}uart_settings_t;

extern volatile bool need_settings;
extern uint8_t sigcfg_packet_space [64];
extern sigconfig_master_t sigcfg_master;


void sigconfig_task(void * p);




#endif /* SIGCONFIG_H_ */
```

## src/signetik.h
```c
/*============================================================================*
 *         Copyright © 2019-2020 Signetik, LLC -- All Rights Reserved         *
 *----------------------------------------------------------------------------*
 *                                                              Signetik, LLC *
 *                                                           www.signetik.com *
 *                                      SPDX-License-Identifier: BSD-4-Clause *
 *============================================================================*/

#define LTE_STACKSIZE 4096
#define LTE_PRIORITY 2

#define MAIN_STACKSIZE 1024
#define MAIN_PRIORITY 5

#ifdef CONFIG_LIS3DH
#define ACCEL_STACKSIZE 1024
#define ACCEL_PRIORITY 7
#endif //CONFIG_LIS3DH

#ifdef CONFIG_HTU21D
#define TEMP_HUMIDITY_STACKSIZE 1024
#define TEMP_HUMIDITY_PRIORITY 7
#endif //CONFIG_HTU21D

#define THREAD_START_DELAY 500 //ms
```

## src/temp_humidity_task.c
```c
/*============================================================================*
 *         Copyright © 2019-2020 Signetik, LLC -- All Rights Reserved         *
 *----------------------------------------------------------------------------*
 *                                                              Signetik, LLC *
 *                                                           www.signetik.com *
 *                                      SPDX-License-Identifier: BSD-4-Clause *
 *============================================================================*/

#include <stdio.h>
#include <string.h>

#include <zephyr.h>
#include <sensor.h>
#include <logging/log.h>
#if defined(CONFIG_REGULATOR)
#include <drivers/regulator.h>
#endif

#include "signetik.h"
#include "temp_humidity_task.h"
#include "cell_packet.h"

LOG_MODULE_REGISTER(th, LOG_LEVEL_INF);

////////////HTU21D
bool temp_humid_data_ready;
K_SEM_DEFINE(sem_th, 0, 1);

struct sensor_value temp_value;
struct sensor_value humidity_value;

void temp_humid_start(void)
{
    temp_humid_data_ready = false;
    k_sem_give(&sem_th);
}

bool temp_humid_ready(void)
{
    return temp_humid_data_ready;
}

void temp_humid_get_data(uint32_t *t, uint32_t *h)
{
	*t = temp_value.val1;
	*h = humidity_value.val1;
}

void read_temp_humidity(struct device *dev)
{
	int ret;
//	struct sensor_value attr;
        temp_humid_data_ready = false;

//	attr.val1 = 150;
//	attr.val2 = 0;
//	ret = sensor_attr_set(dev, SENSOR_CHAN_AMBIENT_TEMP,
//			      SENSOR_ATTR_FULL_SCALE, &attr);
//	if (ret) {
//		printk("sensor_attr_set failed ret %d\n", ret);
//		return;
//	}
//
//	attr.val1 = 8;
//	attr.val2 = 0;
//	ret = sensor_attr_set(dev, SENSOR_CHAN_AMBIENT_TEMP,
//			      SENSOR_ATTR_SAMPLING_FREQUENCY, &attr);
//	if (ret) {
//		printk("sensor_attr_set failed ret %d\n", ret);
//		return;
//	}

    while (1)
    {
        k_sleep(1000);
        k_sem_take(&sem_th, K_FOREVER);

        temp_value.val1 = humidity_value.val1 = 0;
        if (dev) {
#if defined(CONFIG_REGULATOR)
            struct device *reg;

            reg = device_get_binding("lsensor_reg");
            if (reg) {
#if !defined(CONFIG_REGULATOR_ALWAYSON)
                regulator_enable(reg);
#endif
            }
#endif

            ret = sensor_sample_fetch(dev);
            if (ret) {
                LOG_ERR("sensor_sample_fetch failed ret %d", ret);
            }

            ret = sensor_channel_get(dev, SENSOR_CHAN_AMBIENT_TEMP, &temp_value);
            if (ret) {
                LOG_ERR("sensor_channel_get failed ret %d", ret);
            }

            ret = sensor_channel_get(dev, SENSOR_CHAN_HUMIDITY, &humidity_value);
            if (ret) {
                LOG_ERR("sensor_channel_get failed ret %d", ret);
            }

#if defined(CONFIG_REGULATOR)
            if (reg) {
#if !defined(CONFIG_REGULATOR_ALWAYSON)
                regulator_disable(reg);
#endif
            }
#endif
        }

        temp_humid_data_ready = true;

        if (temp_humid_data_ready == true)
        {
            LOG_INF("temp/humid data ready, T=%d, H=%d", temp_value.val1, humidity_value.val1);
        }
    }
}

void temp_humidity_thread(void)
{
    struct device *dev;

    dev = device_get_binding("HTU21D");
    LOG_INF("TH thread, device is %p, name is %s", dev, dev ? dev->config->name : "NOTFOUND");

    read_temp_humidity(dev);
}

#ifdef CONFIG_HTU21D
K_THREAD_DEFINE(temp_humidity_id, TEMP_HUMIDITY_STACKSIZE, temp_humidity_thread, NULL, NULL, NULL,
		TEMP_HUMIDITY_PRIORITY, K_FP_REGS, K_NO_WAIT);
#endif //CONFIG_HTU21D
```

## src/temp_humidity_task.h
```c
/*============================================================================*
 *         Copyright © 2019-2020 Signetik, LLC -- All Rights Reserved         *
 *----------------------------------------------------------------------------*
 *                                                              Signetik, LLC *
 *                                                           www.signetik.com *
 *                                      SPDX-License-Identifier: BSD-4-Clause *
 *============================================================================*/

void temp_humid_start(void);
bool temp_humid_ready(void);
void temp_humid_get_data(uint32_t *t, uint32_t *h);
```
